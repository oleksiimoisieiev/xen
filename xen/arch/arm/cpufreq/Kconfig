## xen/arch/arm/cpufreq/Kconfig
```kconfig
config CPUFREQ_SCPI
	bool "Enable cpufreq_scpi driver"
	default y
	depends on HAS_CPUFREQ && !CPUFREQ_IMX
	help
	  Enable cpufreq_scpi driver. This driver implements CPU
	  frequency scaling mechaninsm via SCPI protocol. It uses
	  mailboxes to communicate with SC-Firmware, which provices
	  SCPI interface to control hardware

config CPUFREQ_IMX
	bool "Enable cpufreq_imx driver"
	default n
	depends on HAS_CPUFREQ && !CPUFREQ_SCPI
	help
	  Enable cpufreg_imx driver. This driver implements CPU
	  frequency scaling for i.MX8 boards. It uses scfw rpc to
	  access hardware resoucers.
```
